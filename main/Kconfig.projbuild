## main/Kconfig.projbuild
```kconfig
menu "ROS 2 camera"

config CAMERA_ROS_AGENT_IP
    string "Default micro-ROS Agent IPv4 address"
    default "192.168.31.69"
    help
        Override and save this address on the Wi-Fi configuration page.

config CAMERA_ROS_AGENT_PORT
    int "Default micro-ROS Agent UDP port"
    range 1 65535
    default 8888

config CAMERA_ROS_DOMAIN_ID
    int "ROS domain ID"
    range 0 232
    default 0

config CAMERA_ROS_TOPIC
    string "CompressedImage topic"
    default "/camera/image_raw/compressed"

config CAMERA_ROS_FRAME_ID
    string "Camera optical frame ID"
    default "camera_optical_frame"

config CAMERA_ROS_FPS
    int "Maximum publish rate (Hz)"
    range 1 30
    default 25
    help
        Actual rate depends on JPEG size, Wi-Fi and Agent acknowledgments.

config CAMERA_ROS_MAX_JPEG_BYTES
    int "Maximum JPEG frame size (bytes)"
    range 16384 262144
    default 131072
    help
        Larger frames are dropped. Reliable XRCE streams fragment frames
        across multiple UDP packets without an extra JPEG copy.

endmenu
```

## sdkconfig.defaults
```kconfig
CONFIG_ESP_CONSOLE_USB_SERIAL_JTAG=y
CONFIG_MBEDTLS_SSL_PROTO_DTLS=y
CONFIG_MBEDTLS_SSL_DTLS_SRTP=y
CONFIG_COMPILER_OPTIMIZATION_SIZE=y
CONFIG_ESP_DEFAULT_CPU_FREQ_MHZ_240=y
```
